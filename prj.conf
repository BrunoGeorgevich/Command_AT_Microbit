## CMakeLists.txt
```
set(BOARD "bbc_microbit")

include($ENV{ZEPHYR_BASE}/cmake/app/boilerplate.cmake NO_POLICY_SCOPE)
project(Comando_AT)

message(WARNING "Main file: ${PROJECT_SOURCE_DIR}/src/main.c")

include_directories(
    "${PROJECT_SOURCE_DIR}/include"
    )

list(APPEND SOURCES
    "${PROJECT_SOURCE_DIR}/src/uart_driver.c"
    "${PROJECT_SOURCE_DIR}/src/ICLEDMatrix.c"
    "${PROJECT_SOURCE_DIR}/src/CommandAT.c"
    "${PROJECT_SOURCE_DIR}/src/main.c"
    )

list(APPEND HEADERS
    "${PROJECT_SOURCE_DIR}/src/ICLEDMatrix.h"
    "${PROJECT_SOURCE_DIR}/src/CommandAT.h"
    )

target_sources(app PRIVATE ${SOURCES})
target_sources(app PRIVATE ${HEADERS})
```

## prj.conf
```kconfig
# nothing here
CONFIG_GPIO=y
CONFIG_MICROBIT_DISPLAY=y
CONFIG_SYS_CLOCK_TICKS_PER_SEC=250
CONFIG_SERIAL=y
CONFIG_UART_INTERRUPT_DRIVEN=y
#CONFIG_MICROBIT_DISPLAY_PIN_GRANULARITY=y
```

## src/main.c
```c
/*
 * Copyright (c) 2017 Intel Corporation
 *
 * SPDX-License-Identifier: Apache-2.0
 *
 * AUTHOR : BRUNO GEORGEVICH FERREIRA
 */

/* CUSTOM LIBS */

#include "uart_driver.h"
#include "ICLEDMatrix.h"
#include "CommandAT.h"

/***************/

int main() {

    CommandATCreateCommand(
                "AT",
                0,
                0,
                CommandAT
                );

    CommandATCreateCommand(
                "LIST",
                0,
                0,
                CommandATPrintCommands
                );

    CommandATCreateCommand(
                "SUM",
                (0 | (INTEGER << BIT0) | (INTEGER << BIT1)),
                2,
                CommandATSum
                );

    CommandATCreateCommand(
                "HEART",
                0,
                0,
                IC_LED_matrix_draw_heart
                );

    CommandATCreateCommand(
                "TIME",
                (0 | (INTEGER << BIT0)),
                1,
                IC_LED_matrix_set_time_active
                );

    CommandATCreateCommand(
                "HOURS",
                (0 | (INTEGER << BIT0) | (INTEGER << BIT1)),
                2,
                IC_LED_matrix_draw_hours
                );

    CommandATCreateCommand(
                "NAME",
                (0 | (STRING << BIT0) | (STRING << BIT1)),
                2,
                IC_LED_matrix_draw_name
                );

    CommandATCreateCommand(
                "DATE",
                (0 | (INTEGER << BIT0) | (STRING << BIT1) | (INTEGER << BIT2) | (INTEGER << BIT3)),
                4,
                IC_LED_matrix_draw_date
                );

    printk("INIT LED PANEL : %d\n", (IC_LED_matrix_init() == 0) ? "OK" : "FAIL");

    DriverOpen();
    DriverSetCallback(CommandATCommandParser);
    return 0;
}
```

## include/ic_assert.h
```c
#ifndef IC_ASSERT_H
#define IC_ASSERT_H


#include <misc/printk.h>

#ifdef ASSERT_ENABLED
#define __ASSERT_POST     \
    for (;;) {            \
        /* spin thread */ \
        k_cpu_idle();     \
    }

#define ASSERT(test, fmt, ...) \
    do {                                                  \
        if (!(test)) {                                    \
            printk("ASSERTION FAIL [%s] @ %s:%d:\n\t",    \
                   #test,                                 \
                   __FILE__,                              \
                   __LINE__);                             \
            printk(fmt, ##__VA_ARGS__);                   \
            __ASSERT_POST                                 \
        }                                                 \
    } while (0)
#else
#define __ASSERT_POST
#define ASSERT(test, fmt, ...)
#endif // ASSERT ENABLED

#endif // IC_ASSERT_H
```

## include/uart_driver.h
```c
#ifndef UART_DRIVER_H
#define UART_DRIVER_H

#include <stdint.h>

void DriverSetCallback(void (*callback)(uint8_t));
uint8_t DriverOpen();
void DriverWrite(uint8_t data);

#endif // UART_DRIVER_H
```

## src/CommandAT.c
```c
/*
 * Copyright (c) 2017 Intel Corporation
 *
 * SPDX-License-Identifier: Apache-2.0
 *
 * AUTHOR : BRUNO GEORGEVICH FERREIRA
 */

#include "CommandAT.h"


/* GLOBAL VARIABLES */

uint8_t  string_params_index = 0;
char string_params_list[MAX_NUM_OF_PARAMS_COMMAND*MAX_NUM_OF_COMMANDS][SIZE_PARAM_DATA_STRING];

uint8_t int_params_index = 0;
uint8_t int_params_list[MAX_NUM_OF_PARAMS_COMMAND*MAX_NUM_OF_COMMANDS];

uint8_t commands_index = 0;
Command commands_list[MAX_NUM_OF_COMMANDS];

uint8_t command_parser_data_index = 0;
char command_parser_data[MAX_SIZE_STRING_DATA];

char substring_buffer[LIMIT_OF_SUBSTRING_BUFFER];
char split_buffer[LIMIT_OF_SPLIT_BUFFER];
char param_data[MAX_SIZE_PARAM_DATA];

/********************/

void CommandATCreateCommand(char *op_name, char param_types, char num_of_params, int (*method)(uint8_t **, uint8_t)) {
    if(commands_index == MAX_NUM_OF_COMMANDS - 1) {
        printk("HAS NO MORE SPACE FOR COMMANDS, ONLY SUPPORTS %d\n", MAX_NUM_OF_COMMANDS);
        return;
    }
    strcpy(commands_list[commands_index].op_name, op_name);
    commands_list[commands_index].num_of_params = num_of_params;
    commands_list[commands_index].param_types = param_types;
    commands_list[commands_index].method = method;

    commands_index++;
}

void CommandATCleanCommandDataArray(char *data, int data_size) {
    if(data == NULL) return;
    memset(data, 0, data_size);
}

int CommandATSearchCommand(char *command_data) {
    for(int i = 0; i < commands_index; i++) {
        if(strcmp(commands_list[i].op_name, command_data) == 0) {
            return i;
        }
    }

    return -1;
}

Command *CommandATGetLastCommand() {
    return &commands_list[commands_index];
}

uint8_t *CommandATAddStringParamToList(char *data) {
    strcpy(string_params_list[string_params_index], data);
    string_params_index++;
    return string_params_list[string_params_index - 1];
}

uint8_t *CommandATAddIntegerParamToList(int data) {
    int_params_list[int_params_index] = data;
    int_params_index++;
    return &int_params_list[int_params_index - 1];
}

char *CommandATGetSubstring(char *string, int init, int end) {

    if(end-init <= 0) {
        return NULL;
    } else if(end > strlen(string)) {
        return NULL;
    }

    for(int index = init; index <= end; index++) {
        if(index == end) {
            substring_buffer[index - init] = '\0';
        } else {
            substring_buffer[index - init] = string[index];
        }
    }

    return substring_buffer;
}

char *CommandATSplit(char *string, int index, char delimiter) {
    if(string == NULL) string = split_buffer;
    int str_len = strlen(string);

    for(int i = 0; i < str_len; i++) {
        split_buffer[i] = string[i];
    }
    split_buffer[str_len] = '\0';

    int init = 0;
    int end = str_len;
    int enter_quotes = 0;
    for(int i = 0; i < str_len; i++) {
        if(split_buffer[i] == '\"' && delimiter != '\"') {
            enter_quotes = !enter_quotes;
        }
        else if(split_buffer[i] == delimiter && !enter_quotes) {
            if(index > 0) {
                index--;
                init = i + 1;
            } else {
                end = i;
                break;
            }
        }
    }
    if(index > 0) {
        //        printk("INDEX :: %d <-> STR :: %s\n", index, CommandATGetSubstring(split_buffer, init, end));
        return NULL;
    }

    return CommandATGetSubstring(split_buffer, init, end);
}

void CommandATInvoker(char *command_data) {
    char *command_name = CommandATSplit(command_data, 1, '+'); //Only to remove AT+
    command_name = CommandATSplit(command_name,0,'=');
    if(command_name == NULL) {
        printk("Command is not valid! Use 'LIST' to show all Commands\n");
        return;
    }

    printk("\nCOMMAND NAME :: %s\n", command_name);

    int command_index = CommandATSearchCommand(command_name);
    if(command_index == -1) {
        printk("Command is not valid! Use 'LIST' to show all Commands\n");
        return;
    }

    Command *current_command = &commands_list[command_index];

    uint8_t params_size = 0;
    uint8_t *params[current_command->num_of_params];

    while(params_size < current_command->num_of_params) {
        char param_str[MAX_SIZE_PARAM_DATA];
        strcpy(param_str, CommandATSplit(command_data,1,'='));

        memset(param_data, 0, MAX_SIZE_PARAM_DATA);
        char *params_splitted_data = CommandATSplit(param_str, params_size, ',');

        if(params_splitted_data == NULL) {
            printk("PARAM [%d] WAS NULL\n", params_size);
            break;
        }

        strcpy(param_data, params_splitted_data);

        if(params_size == MAX_NUM_OF_PARAMS_COMMAND - 1) {
            printk("ONLY SUPPORT %d PARAMETERS\n", MAX_NUM_OF_PARAMS_COMMAND);
            break;
        }
        if(param_data[0] == '\"') {
            char *data = CommandATSplit(params_splitted_data,1,'\"');
            params[params_size] = CommandATAddStringParamToList(data);
            printk("COMMAND PARAMETER [%d][STRING] :: %s\n",params_size, data);
        } else {
            params[params_size] = CommandATAddIntegerParamToList(atoi(param_data));
            printk("COMMAND PARAMETER [%d][INT] :: %d\n",params_size, atoi(param_data));
        }
        params_size++;
    }

    printk("COMMAND RETURN :: %s\n", (current_command->method(params, params_size) == 0) ? "Ok" : "Fail");
}

void CommandATCommandParser(uint8_t data) {
    // CHAR 13 IS \n
    if(data == 13) {
        CommandATInvoker(command_parser_data);
        command_parser_data_index = 0;
        CommandATCleanCommandDataArray(command_parser_data, MAX_SIZE_STRING_DATA);
    } else {
        printk("%c", data);
        command_parser_data[command_parser_data_index] = data;
        command_parser_data_index++;
    }
}


int CommandAT(uint8_t **data, uint8_t size)
{
    UNUSED(data); UNUSED(size);
    return kOK;
}

int CommandATPrintCommands(uint8_t **data, uint8_t size){
    UNUSED(data); UNUSED(size);
    for(int k = 0; k < commands_index; k++) {
        Command *command = &commands_list[k];
        printk("\nCOMMAND {\n");
        printk("\tOP_NAME     = %s\n", command->op_name);
        printk("\tPARAM_TYPES = %d\n", command->param_types);
        printk("\tNUM_PARAMS  = %d\n", command->num_of_params);
        printk("}\n");
    }
    return kOK;
}

int CommandATSum(uint8_t **data, uint8_t size) {
    if(size != 2) {
        printk("SUM only supports 2 parameters\n");
        return kFAIL;
    }

    int a = *CAST(data[0], uint8_t *);
    int b = *CAST(data[1], uint8_t *);
    printk("SUM IS :: %d\n", a+b);
    return kOK;
}
```

## src/CommandAT.h
```c
/*
 * Copyright (c) 2017 Intel Corporation
 *
 * SPDX-License-Identifier: Apache-2.0
 *
 * AUTHOR : BRUNO GEORGEVICH FERREIRA
 */

#ifndef COMMANDAT_H
#define COMMANDAT_H

#include <zephyr.h>
#include <misc/printk.h>
#include <board.h>
#include <gpio.h>
#include <device.h>

#include <display/mb_display.h>

#include <string.h>
#include <stdio.h>
#include <stdlib.h>

#define kOK     0
#define kFAIL   1

#define BIT0    0
#define BIT1    1
#define BIT2    2
#define BIT3    3
#define BIT4    4
#define BIT5    5
#define BIT6    6
#define BIT7    7

#define STRING  1
#define INTEGER 0

#define SIZE_COMMAND_NAME_STRING    8
#define SIZE_PARAM_DATA_STRING      8

#define MAX_NUM_OF_PARAMS_COMMAND   8
#define MAX_SIZE_STRING_DATA        40
#define MAX_SIZE_PARAM_DATA         20
#define MAX_NUM_OF_COMMANDS   	    8

#define LIMIT_OF_SUBSTRING_BUFFER   40
#define LIMIT_OF_SPLIT_BUFFER       40

#define CAST(valor, tipo) ((tipo) (valor))
#define ASCII_TO_INT(x) x - '0'
#define UNUSED(x) (void)(x)

typedef struct {
    char op_name[SIZE_COMMAND_NAME_STRING];
    char param_types;
    char num_of_params;
    int  (*method)(uint8_t **, uint8_t);
//    void *command_params[MAX_NUM_OF_PARAMS_COMMAND];
} Command;

void CommandATCreateCommand(char *op_name, char param_types, char num_of_params, int  (*method)(uint8_t **data, uint8_t size));

void CommandATCleanCommandDataArray(char *data, int data_size);

int CommandATSearchCommand(char *command_data);

Command *CommandATGetLastCommand();

uint8_t *CommandATAddStringParamToList(char *data);

uint8_t *CommandATAddIntegerParamToList(int data);

char *CommandATGetSubstring(char *string, int init, int end);

char *CommandATSplit(char *string, int index, char delimiter);

void CommandATInvoker(char *command_data);

void CommandATCommandParser(uint8_t data);


/* CALLBACKS FUNCTIONS */

int CommandAT(uint8_t **data, uint8_t size);

int CommandATPrintCommands(uint8_t **data, uint8_t size);

int CommandATSum(uint8_t **data, uint8_t size);

/***********************/

#endif //COMMANDAT_H
```

## src/ICLEDMatrix.c
```c
//
// Created by matheuswhite on 19/03/18.
//

#include "ICLEDMatrix.h"

static bool __is_initialized = false;
static struct mb_image __heart = MB_IMAGE({ 0, 1, 0, 1, 0 },
                                        { 1, 1, 1, 1, 1 },
                                        { 1, 1, 1, 1, 1 },
                                        { 0, 1, 1, 1, 0 },
                                        { 0, 0, 1, 0, 0 });
static struct mb_display *__display;
static uint8_t __time_active;

int IC_LED_matrix_init(void)
{
    if (__is_initialized) {
        printk("[LED Matrix|Error|%d] Module already initialized!\n",
               __LINE__);
        return -ENOT_INIT;
    }

    printk("[LED Matrix|Error|%d] Initializing module...\n", __LINE__);
    __display = mb_display_get();
    __is_initialized = true;
    __time_active = 5;
    printk("[LED Matrix|Error|%d] Module initialized!\n", __LINE__);

    return 0;
}

int IC_LED_matrix_draw_heart(uint8_t **data, uint8_t size)
{
    if (!__is_initialized) {
        printk("[LED Matrix|Error|%d] Module not initialized!\n", __LINE__);
        return -ENOT_INIT;
    }

    if (size != 0) {
        printk("[LED Matrix|Error|%d] Size wrong!\n", __LINE__);
        return -ESIZE_WRONG;
    }

    printk("[LED Matrix|Error|%d] Drawing a heart and showing for %d seconds."
           "\n", __LINE__, __time_active);
    mb_display_image(__display, MB_DISPLAY_MODE_SINGLE,
                     K_SECONDS(__time_active), &__heart, 1);
    k_sleep(K_SECONDS(__time_active));

    return 0;
}

int IC_LED_matrix_set_time_active(uint8_t **data, uint8_t size)
{
    if (size != 1) {
        printk("[LED Matrix|Error|%d] Size wrong!\n", __LINE__);
        return -ESIZE_WRONG;
    }

    uint8_t seconds = *(data[0]);

    printk("[LED Matrix|%d] Old time active: %d, new time active: %d!\n",
           __LINE__, __time_active, seconds);

    __time_active = seconds;

    return 0;
}

int IC_LED_matrix_draw_hours(uint8_t **data, uint8_t size)
{
    if (!__is_initialized) {
        printk("[LED Matrix|Error|%d] Module not initialized!\n", __LINE__);
        return -ENOT_INIT;
    }

    if (size != 2) {
        printk("[LED Matrix|Error|%d] Size wrong!\n", __LINE__);
        return -ESIZE_WRONG;
    }

    uint8_t hour = *(data[0]);
    uint8_t min = *(data[1]);

    if (hour > 23 || min > 59) {
        printk("[LED Matrix|Error|%d] Format not supported!\n", __LINE__);
        return -EHOUR_INVALID;
    }

    char output[6];
    snprintk(output, 6, "%02d:%02d", hour, min);

    printk("[LED Matrix|Error|%d] Drawing %s.\n", __LINE__, output);

    mb_display_print(__display, MB_DISPLAY_MODE_SINGLE, K_SECONDS(1), output);
    k_sleep(K_SECONDS(5));

    return 0;
}

int IC_LED_matrix_draw_string(uint8_t **data, uint8_t size)
{
    if (!__is_initialized) {
        printk("[LED Matrix|Error|%d] Module not initialized!\n", __LINE__);
        return -ENOT_INIT;
    }

    if (size != 1) {
        printk("[LED Matrix|Error|%d] Size wrong!\n", __LINE__);
        return -ESIZE_WRONG;
    }

    char *str = (char *)(data[0]);

    for (size_t i = 0; i < strlen(str); ++i) {
        if (str[i] < 0x20 || str[i] > 0x7E) {
            printk("[LED Matrix|Error|%d] Format not supported!\n", __LINE__);
            return -ENOT_ASCII;
        }
    }

    printk("[LED Matrix|Error|%d] Drawing %s.\n", __LINE__, str);

    mb_display_print(__display, MB_DISPLAY_MODE_SINGLE, K_SECONDS(1), str);
    k_sleep(K_SECONDS(1)*strlen(str));

    return 0;
}

int IC_LED_matrix_draw_name(uint8_t **data, uint8_t size)
{
    if (!__is_initialized) {
        printk("[LED Matrix|Error|%d] Module not initialized!\n", __LINE__);
        return -ENOT_INIT;
    }

    if (size != 2) {
        printk("[LED Matrix|Error|%d] Size wrong!\n", __LINE__);
        return -ESIZE_WRONG;
    }

    char *name = (char *)(data[0]);
    char *surname = (char *)(data[1]);

    for (size_t i = 0; i < strlen(name); ++i) {
        if (name[i] < 0x20 || name[i] > 0x7E) {
            printk("[LED Matrix|Error|%d] Format not supported!\n", __LINE__);
            return -ENOT_ASCII;
        }
    }

    for (size_t i = 0; i < strlen(surname); ++i) {
        if (surname[i] < 0x20 || surname[i] > 0x7E) {
            printk("[LED Matrix|Error|%d] Format not supported!\n", __LINE__);
            return -ENOT_ASCII;
        }
    }

    size_t length = strlen(name)+strlen(surname)+2;
    char output[length];
    snprintk(output, length, "%s-%s", name, surname);

    printk("[LED Matrix|Error|%d] Drawing %s.\n", __LINE__, output);

    mb_display_print(__display, MB_DISPLAY_MODE_SINGLE, K_SECONDS(1), output);
    k_sleep(K_SECONDS(1)*(length-1));

    return 0;
}

int IC_LED_matrix_draw_date(uint8_t **data, uint8_t size)
{
    if (!__is_initialized) {
        printk("[LED Matrix|Error|%d] Module not initialized!\n", __LINE__);
        return -ENOT_INIT;
    }

    if (size != 4) {
        printk("[LED Matrix|Error|%d] Size wrong!\n", __LINE__);
        return -ESIZE_WRONG;
    }

    uint8_t day = *(data[0]);
    char *month = (char *)(data[1]);
    uint16_t year = ((*(data[3])) << 8) | (*(data[2]));

    if (strlen(month) != 3 || day > 31) {
        printk("[LED Matrix|Error|%d] Format not supported!\n", __LINE__);
        return -EDATE_FMT_WRONG;
    }

    for (size_t i = 0; i < strlen(month); ++i) {
        if (month[i] < 0x20 || month[i] > 0x7E) {
            printk("[LED Matrix|Error|%d] Format not supported!\n", __LINE__);
            return -ENOT_ASCII;
        }
    }

    char output[12];
    snprintk(output, 12, "%02d-%s-%04d", day, month, year);

    printk("[LED Matrix|Error|%d] Drawing %s.\n", __LINE__, output);

    mb_display_print(__display, MB_DISPLAY_MODE_SINGLE, K_SECONDS(1), output);
    k_sleep(K_SECONDS(11));

    return 0;
}
```

## src/ICLEDMatrix.h
```c
//
// Created by matheuswhite on 19/03/18.
//

#ifndef PROJECT_ICLEDMATRIX_H
#define PROJECT_ICLEDMATRIX_H

#include <stdint.h>
#include <stdbool.h>
#include <string.h>

#include <zephyr.h>
#include <misc/printk.h>
#include <board.h>
#include <gpio.h>
#include <device.h>
#include <display/mb_display.h>

#define ENOT_INIT       1
#define EHOUR_INVALID   2
#define ENOT_ASCII      3
#define EDATE_FMT_WRONG 4
#define ESIZE_WRONG     5

/*!
 * @brief This function initialize the module: "LED Matrix"
 * @return kOK if the module has not been initialized. And, kFAIL otherwise.
 */
int IC_LED_matrix_init(void);

/*! 
 * @brief
 * This function draw a heart in the LED Matrix. This heart will remain in the
 * LED Matrix, by default, 5 seconds.
 *
 * AT+HEART
 *
 * @param data - An array of pointers of type uint8_t
 * @param size - The size of array 'data'.
 * @return kOK if the module has been initialized. And kFAIL, otherwise.
 */
int IC_LED_matrix_draw_heart(uint8_t **data, uint8_t size);

/*!
 * @
 * @brief
 * This function change the time the heart remains in the LED Matrix
 *
 * AT+TIME=<int>
 *
 * @param data - An array of pointers of type uint8_t
 * @param size - The size of array 'data'.
 * 1º PARAMETRO: seconds - A unsigned integer that represent the seconds in
 *                         which the heart will remain in the LED matrix.
 * @return kOK if the module has been initialized. And kFAIL, otherwise.
 */
int IC_LED_matrix_set_time_active(uint8_t **data, uint8_t size);

/*!
 * @at_command
 * @brief
 * This function will draw, in the LED Matrix, a hour and a minute. Each number
 * will be shown sequentially, and will stay in the LED Matrix for 1 seconds.
 * The hour will be followed by ":".
 *
 * AT+HOURS=<int>,<int>
 *
 * @param data - An array of pointers of type uint8_t
 * @param size - The size of array 'data'.
 * 1º PARAMETRO: hour - A unsigned integer that represent the hours. This value
 *                      must be less than 24.
 * 2º PARAMETRO: min - A unsigned integer that represent the minutes. This
 *                     value must be less than 60.
 * @return kOK if the module has been initialized and the conditions of above
 *         params has been met. And kFAIL, otherwise.
 */
int IC_LED_matrix_draw_hours(uint8_t **data, uint8_t size);

/*!
 * @brief
 * This function will draw, in the LED Matrix, an any string. Each character
 * will be shown sequentially, and will stay in the LED Matrix for 1 seconds.
 *
 * AT+STRING=<str>
 *
 * @param data - An array of pointers of type uint8_t
 * @param size - The size of array 'data'.
 * 1º PARAMETRO: str - A generic string. The characters of this string must be
 *                     between 0x20 and 0x7E.
 * @return kOK if the module has been initialized and the conditions of above
 *         params has been met. And kFAIL, otherwise.
 */
int IC_LED_matrix_draw_string(uint8_t **data, uint8_t size);

/*!
 * @brief
 * This function will draw, in the LED Matrix: a name and a surname. Each
 * character will be shown sequentially, and will stay in the LED Matrix for
 * 1 seconds. The name and surname will be separated by a hyphen.
 *
 * AT+NAME=<str>,<str>
 *
 * @param data - An array of pointers of type uint8_t
 * @param size - The size of array 'data'.
 * 1º PARAMETRO: name - A string that represent a name. The characters of this
 *                      string must be between 0x20 and 0x7E.
 * 2º PARAMETRO: surname - A string that represent a surname. The characters
 *                         of this string must be between 0x20 and 0x7E.
 * @return kOK if the module has been initialized and the conditions of above
 *         params has been met. And kFAIL, otherwise.
 */
int IC_LED_matrix_draw_name(uint8_t **data, uint8_t size);

/*!
 * @brief
 * This function will draw, in the LED Matrix, a date. Each character
 * (or number) will be shown sequentially, and will stay in the LED Matrix for
 * 1 seconds. The day, the month and the year will be separated by a hyphen.
 *
 * AT+DATE=<int>,<str>,<int>
 *
 * @param data - An array of pointers of type uint8_t
 * @param size - The size of array 'data'.
 * 1º PARAMETRO: day - A unsigned integer that represent the day of a date.
 *                     This value must be less than 32.
 * 2º PARAMETRO: month - A string that represent the month of a date. The
 *                       length of this string must be less than 3 and the
 *                       characters of this string must be between 0x20 and
 *                       0x7E.
 * 3º PARAMETRO: year - A unsigned integer that represent the first byte of a
 *                      year of a date.
 * 4º PARAMETRO: year - A unsigned integer that represent the second byte of a
 *                      year of a date.
 * @return kOK if the module has been initialized and the conditions of above
 *         params has been met. And kFAIL, otherwise.
 */
int IC_LED_matrix_draw_date(uint8_t **data, uint8_t size);

#endif //PROJECT_ICLEDMATRIX_H
```

## src/uart_driver.c
```c
/*
 * Copyright (c) 2012-2014 Wind River Systems, Inc.
 *
 * SPDX-License-Identifier: Apache-2.0
 */
#include "uart_driver.h"

#include <zephyr.h>
#include <device.h>
#include <misc/printk.h>
#include <uart.h>

static void (*uart_callback)(uint8_t) = 0;

void DriverSetCallback(void (*callback)(uint8_t)) {
    uart_callback = callback;
}

static void uart_fifo_callback(struct device *dev)
{
    u8_t recvData;
    /* Verify uart_irq_update() */
    if (!uart_irq_update(dev)) {
        printk("retval should always be 1\n");
        return;
    }
    /* Verify uart_irq_rx_ready() */
    if (uart_irq_rx_ready(dev)) {
        /* Verify uart_fifo_read() */
        uart_fifo_read(dev, &recvData, 1);
        if(uart_callback) {
            uart_callback(recvData);
        }
    }
}

uint8_t DriverOpen() {
    struct device *uart_dev = device_get_binding("UART_0");
    if(!uart_dev) {
    printk("Problem to load uart device\n");
        return 1;
    }
    printk("UART device loaded successfully!\n");

    /* Verify uart_irq_callback_set() */
    uart_irq_callback_set(uart_dev, uart_fifo_callback);

    /* Enable Tx/Rx interrupt before using fifo */
    /* Verify uart_irq_rx_enable() */
    uart_irq_rx_enable(uart_dev);
    printk("Now you can start sending AT commands\n");
    return 0;
}

void DriverWrite(uint8_t data) {
    printk("%c", (char) data);
}
```
